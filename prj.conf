## CMakeLists.txt
```
cmake_minimum_required(VERSION 3.13.1)
include($ENV{ZEPHYR_BASE}/cmake/app/boilerplate.cmake NO_POLICY_SCOPE)
project(hackathon_template_app)

FILE(GLOB app_sources src/*.c)
target_sources(app PRIVATE ${app_sources})
zephyr_include_directories(include/)
```

## prj.conf
```kconfig
CONFIG_LOG_DEFAULT_LEVEL=4
CONFIG_LOG_BUFFER_SIZE=4096
CONFIG_ASSERT=y
CONFIG_LOG=y
CONFIG_PRINTK=y
CONFIG_GPIO=y

CONFIG_SENSOR=y

CONFIG_BT_DEVICE_NAME="zephyr-example-device"
CONFIG_BT=y
CONFIG_BT_DEBUG_LOG=n
CONFIG_BT_PERIPHERAL=y

CONFIG_DEBUG=y
CONFIG_STACK_USAGE=y
CONFIG_STACK_SENTINEL=y
CONFIG_CONSOLE=y
CONFIG_USE_SEGGER_RTT=y
CONFIG_RTT_CONSOLE=y

CONFIG_ADC=y
CONFIG_ADC_ASYNC=y
CONFIG_ADC_0=y
```

## src/main.c
```c
#define LOG_LEVEL CONFIG_LOG_DEFAULT_LEVEL
#include <logging/log.h>
LOG_MODULE_REGISTER(main);

#include <zephyr.h>
#include <assert.h>

#include "ble_manager.h"
#include "vcc.h"

void main(void) {
	int ret;

	LOG_INF("Initializing BLE manager");
	ret = ble_init();
	if (ret != 0){
		LOG_ERR("Could not initialize BLE manager");
	}

	while (1) {
		k_sleep(K_SECONDS(5));

		struct vcc_sample sample;
		ret = vcc_get_latest(&sample);
		if (ret != 0) {
			LOG_ERR("vcc_get_latest returned %d", ret);
		} else {
			LOG_DBG("vcc = %hi, timestamp = %u",
				sample.sample, sample.timestamp);
		}
	}
}
```

## include/ble_manager.h
```c
#ifndef _MEIVA_BLE_MANAGER_H
#define _MEIVA_BLE_MANAGER_H

int ble_init(void);

#endif /* _MEIVA_BLE_MANAGER_H */
```

## include/vcc.h
```c
#include <zephyr.h>

struct vcc_sample {
	s16_t sample;
	u64_t timestamp;
} __packed;

int vcc_get_latest(struct vcc_sample *sample);
```

## src/ble_manager.c
```c
#define LOG_LEVEL CONFIG_LOG_DEFAULT_LEVEL
#include <logging/log.h>
LOG_MODULE_REGISTER(ble_manager);

#include <zephyr.h>
#include <bluetooth/bluetooth.h>
#include <bluetooth/hci.h>
#include <bluetooth/conn.h>
#include <bluetooth/uuid.h>
#include <bluetooth/gatt.h>
#include <gpio.h>

#include "vcc.h"

static u8_t write_led_buffer[2];
static u8_t adc_gatt_buffer[100];

// Primary service: 0ded4e00-e8e3-2083-094f-431901433ad2

/* This is the service */
static struct bt_uuid_128 example_service_uuid =
	BT_UUID_INIT_128(0xd2, 0x3a, 0x43, 0x01, 0x19, 0x43, 0x4f, 0x09, 0x83,
			 0x20, 0xe3, 0xe8,
			 /* important part: */ 0x00, 0x3e, 0x7d, 0xad);

static const struct bt_uuid_128 adc_read_uuid =
	BT_UUID_INIT_128(0xd2, 0x3a, 0x43, 0x01, 0x19, 0x43, 0x4f, 0x09, 0x83,
			 0x20, 0xe3, 0xe8,
			 /* important part: */ 0x01, 0x3e, 0x7d, 0xad);

static const struct bt_uuid_128 write_led_uuid =
	BT_UUID_INIT_128(0xd2, 0x3a, 0x43, 0x01, 0x19, 0x43, 0x4f, 0x09, 0x83,
			 0x20, 0xe3, 0xe8,
			 /* important part: */ 0x02, 0x3e, 0x7d, 0xad);

static const struct bt_data ad[] = {
	BT_DATA_BYTES(BT_DATA_FLAGS, (BT_LE_AD_GENERAL | BT_LE_AD_NO_BREDR)),
	BT_DATA_BYTES(BT_DATA_UUID16_ALL, 0x0a, 0x18), // FIXME: what's this
	BT_DATA_BYTES(BT_DATA_UUID128_ALL,
		      0xd2, 0x3a, 0x43, 0x01, 0x19, 0x43,
		      0x4f, 0x09, 0x83, 0x20, 0xe3, 0xe8,
		      0x00, 0x3e, 0x7d, 0xad),
};

static ssize_t read_adc(struct bt_conn *conn,
			const struct bt_gatt_attr *attr, void *buf,
			u16_t len, u16_t offset)
{
	LOG_DBG("len = %u, offset = %u", len, offset);
	void *value = attr->user_data;
	int ret;
	struct vcc_sample sample;

	ret = vcc_get_latest(&sample);
	if (ret != 0) {
		LOG_ERR("read_adc returned %d", ret);
		return ret;
	}
	memcpy(value, &sample, sizeof(sample));

	return bt_gatt_attr_read(
		conn, attr, buf, len, offset, value, sizeof(sample));
}


/* Hardcoding the number of LEDs is clearly not the most portable solution. But
 * it is the fastest to implement :) */
#define NUM_LEDS 4
static struct device *gpio_dev[NUM_LEDS];
static int gpio_pin[NUM_LEDS];

static int do_write_led(u8_t led, u8_t val)
{
	LOG_DBG("Writing %X to %X", !val, led);

	/* LEDs are enabled by writing 0, so we flip the value */
	return gpio_pin_write(gpio_dev[led], gpio_pin[led], !val);
}

static void init_gpio_leds(void)
{
	gpio_dev[0] = device_get_binding(DT_GPIO_LEDS_LED_0_GPIO_CONTROLLER);
	gpio_dev[1] = device_get_binding(DT_GPIO_LEDS_LED_1_GPIO_CONTROLLER);
	gpio_dev[2] = device_get_binding(DT_GPIO_LEDS_LED_2_GPIO_CONTROLLER);
	gpio_dev[3] = device_get_binding(DT_GPIO_LEDS_LED_3_GPIO_CONTROLLER);

	__ASSERT_NO_MSG(gpio_dev[0]);
	__ASSERT_NO_MSG(gpio_dev[1]);
	__ASSERT_NO_MSG(gpio_dev[2]);
	__ASSERT_NO_MSG(gpio_dev[3]);

	gpio_pin[0] = DT_GPIO_LEDS_LED_0_GPIO_PIN;
	gpio_pin[1] = DT_GPIO_LEDS_LED_1_GPIO_PIN;
	gpio_pin[2] = DT_GPIO_LEDS_LED_2_GPIO_PIN;
	gpio_pin[3] = DT_GPIO_LEDS_LED_3_GPIO_PIN;

	/* Configure GPIOs, turn them off */
	for (u8_t i = 0; i < NUM_LEDS; i++) {
		gpio_pin_configure(gpio_dev[i], gpio_pin[i], GPIO_DIR_OUT);
		do_write_led(i, 0);
	}
}

/* Callback that gets called when someone writes to the led characteristic.
 * Expects user to write byte array containing [LED_IDX, LED_VAL]. */
static ssize_t write_led(struct bt_conn *conn, const struct bt_gatt_attr *attr,
			 const void *buf, u16_t len, u16_t offset, u8_t flags)
{
	if (len != sizeof(write_led_buffer)) {
		return -EINVAL;
	}

	// command written is contained in *buf
	u8_t *cmd = (u8_t *)buf;
	u8_t led = cmd[0];
	u8_t val = cmd[1];

	if (led > NUM_LEDS) {
		return -EINVAL;
	}
	if (val > 1) {
		return -EINVAL;
	}

	do_write_led(led, val);

	return len;
}

static struct bt_gatt_attr service_attrs[] = {
	BT_GATT_PRIMARY_SERVICE(&example_service_uuid),
/* -- Read ADC characteristic */
	BT_GATT_CHARACTERISTIC(&adc_read_uuid.uuid,	/* UUID */
			       BT_GATT_CHRC_READ,	/* Properties, i.e. read, write, .. */
			       BT_GATT_PERM_READ,	/* Permissions */
			       read_adc,		/* Read callback */
			       NULL,			/* Write callback */
			       adc_gatt_buffer),	/* Value storage */

/* -- Write LED characteristic */
	BT_GATT_CHARACTERISTIC(&write_led_uuid.uuid,
			       BT_GATT_CHRC_WRITE,
			       BT_GATT_PERM_WRITE,
			       NULL,
			       write_led,
			       write_led_buffer),
};

static struct bt_gatt_service example_service = BT_GATT_SERVICE(service_attrs);

static void connected(struct bt_conn *conn, u8_t err)
{
	if (err) {
		LOG_ERR("Connection failed (err %u)", err);
	} else {
		LOG_INF("Connected");
	}
}

static void disconnected(struct bt_conn *conn, u8_t reason)
{
	LOG_INF("Disconnected (reason %u)", reason);
}

static struct bt_conn_cb conn_callbacks = {
	.connected = connected,
	.disconnected = disconnected,
};

int ble_init(void)
{
	int err;

	init_gpio_leds();

	err = bt_enable(NULL);
	if (err) {
		LOG_ERR("Bluetooth init failed (err %d)", err);
		return err;
	}

	LOG_INF("Bluetooth initialized");

	bt_conn_cb_register(&conn_callbacks);
	bt_gatt_service_register(&example_service);

	err = bt_le_adv_start(BT_LE_ADV_CONN_NAME, ad, ARRAY_SIZE(ad), NULL, 0);
	if (err) {
		LOG_ERR("Advertising failed to start (err %d)", err);
		return err;
	}

	LOG_INF("Advertising successfully started");
	return 0;
}
```

## src/vcc.c
```c
#define LOG_LEVEL CONFIG_LOG_DEFAULT_LEVEL
#include <logging/log.h>
LOG_MODULE_REGISTER(vcc);

#include <zephyr.h>
#include <init.h>
#include <adc.h>

#include "vcc.h"

/* Channel number 8 <=> AIN7 <=> P0.31 */
/* Channel number 4 <=> AIN3 <=> P0.05 */
#define VCC_ADC_CHANNEL 4
#define VCC_POLLER_STACK_SIZE 512

/* Normally, the ADC uses VCC as its reference. But it doesn't make much sense
 * if VCC is what we're trying to measure. Luckily, the nRF52 supplies an
 * internal, constant 0.6V reference voltage. */
#define VCC_ADC_REF ADC_REF_INTERNAL
#define VCC_POLL_RESOLUTION 12		/* 12 bit resolution */
#define VCC_POLL_OVERSAMP 3		/* Take average over 2^3 samples */
#define VCC_POLL_SLEEP_TIME (1 * 1000)	/* One second sampling interval */

K_THREAD_STACK_DEFINE(vcc_poller_stack_area, VCC_POLLER_STACK_SIZE);
struct k_thread vcc_poller_thread_data;
static k_tid_t vcc_poller_tid;

struct k_poll_signal vcc_signal;
struct k_poll_event  vcc_event;

/* Signal definition for data ready */
#define VCC_DATA_RDY 0x100

static struct vcc_sample cur_sample;

/* The function which is run by the polling thread. Observant readers will note
 * that a thread is really not necessary here -- it would be better to just call
 * adc_read directly from vcc_get_latest(). */
static void vcc_poll_fn(void *dev_ptr, void *p2, void *p3)
{
	ARG_UNUSED(p2);
	ARG_UNUSED(p3);

	int ret;
	s16_t sample;
	u64_t timestamp;
	struct device *adc_dev = dev_ptr;

	struct adc_sequence seq = {
		.resolution	  = VCC_POLL_RESOLUTION,
		.oversampling = VCC_POLL_OVERSAMP,
		.channels  = 1 << VCC_ADC_CHANNEL,
		.buffer	 = &sample,
		.buffer_size  = sizeof(sample),
	};

	while (1) {
		ret = adc_read(adc_dev, &seq);
		timestamp = k_uptime_get();
		if (ret != 0) {
			LOG_WRN("adc_read returned %d", ret);
			goto sleep;
		}

		/* LOG_DBG("sample = %hi, timestamp = %u", */
			/* sample, timestamp); */

		/* lock scheduler */
		k_sched_lock();
		cur_sample.sample = sample;
		cur_sample.timestamp = timestamp;
		k_sched_unlock();
	sleep:
		k_sleep(VCC_POLL_SLEEP_TIME);
	}
}

int vcc_get_latest(struct vcc_sample *sample)
{
	/* Note: k_sched_lock() is a convenient, but pretty hand-wavy, way to
	 * synchronize data access. If you're new to Zephyr, you may find it
	 * educational to replace it with something more idiomatic. Check out
	 * include/kernel.h for some nice data structures:
	 *     k_msg, k_mbox, k_pipe, k_queue, k_fifo, k_lifo and k_stack all
	 * have their use cases. See also include/atomic.h */
	k_sched_lock();

	if ((0 == cur_sample.timestamp) && (0 == cur_sample.sample)) {
		/* ADC hasn't been sampled yet */
		return -EAGAIN;
	}

	*sample = cur_sample;

	k_sched_unlock();
	return 0;
}

/* Initialization function */
int vcc_init(struct device *dev)
{
	ARG_UNUSED(dev);

	int ret;
	struct device *adc_dev;
	static struct adc_channel_cfg channel_cfg;

	adc_dev = device_get_binding(DT_ADC_0_NAME);
	__ASSERT_NO_MSG(adc_dev);

	/* Configure the ADC  */
	/* [V(P) – V(N) ] * GAIN/REFERENCE * 2(RESOLUTION - m) */
	// = (1/6) / 0.6 = 0.1
	channel_cfg = (struct adc_channel_cfg) {
		.channel_id	  = VCC_ADC_CHANNEL,
		.gain		  = ADC_GAIN_1_6,
		.reference	  = ADC_REF_INTERNAL,
		.acquisition_time = ADC_ACQ_TIME_DEFAULT,
		.input_positive	  = VCC_ADC_CHANNEL,
		.differential	  = 0,
		.input_negative	  = 0
	};
	ret = adc_channel_setup(adc_dev, &channel_cfg);
	__ASSERT(0 == ret, "adc_channel_setup returned %d", ret);

	k_poll_signal_init(&vcc_signal);
	vcc_event = (struct k_poll_event)
		K_POLL_EVENT_INITIALIZER(K_POLL_TYPE_SIGNAL,
					 K_POLL_MODE_NOTIFY_ONLY,
					 &vcc_signal);


	/* Start ADC polling thread */
	vcc_poller_tid = k_thread_create(
		&vcc_poller_thread_data,
		vcc_poller_stack_area,
		VCC_POLLER_STACK_SIZE,
		vcc_poll_fn,		// entry point
		adc_dev,		// *p1 -- sensor port ID
		NULL,			// *p2 -- unused
		NULL,			// *p3 -- unused
		9,
		0,			// flags
		0			// delay
		);

	return 0;
}

SYS_INIT(vcc_init, POST_KERNEL, 80);
```
